## examples/camera/Kconfig
```kconfig
#
# For a description of the syntax of this configuration file,
# see the file kconfig-language.txt in the NuttX tools repository.
#

config EXAMPLES_CAMERA
	tristate "Camera example"
	default n
	---help---
		Enable the camera example

if EXAMPLES_CAMERA

config EXAMPLES_CAMERA_PROGNAME
	string "Program name"
	default "camera"
	---help---
		This is the name of the program that will be use when the NSH ELF
		program is installed.

config EXAMPLES_CAMERA_PRIORITY
	int "Camera task priority"
	default 100

config EXAMPLES_CAMERA_STACKSIZE
	int "Camera stack size"
	default 2048

config EXAMPLES_CAMERA_OUTPUT_LCD
	bool "Output to LCD"
	default n
	---help---
		This enables to output the captured RGB565 image to LCD.

config EXAMPLES_CAMERA_IMAGE_JPG_SIZE
	int "Image buffer size for JPEG data"
	default 524288
	---help---
		The size of the buffer used for capturing still data.
		Default:52288 (= 512x1024)

config EXAMPLES_CAMERA_IMAGE_RGB_SIZE
	int "Image buffer size for RGB data"
	default 153600
	---help---
		The size of the buffer used for capturing video data.
		Default:153600 (= 320x240x2) at QVGA RGB565 format 

config EXAMPLES_CAMERA_VIDEO_BUFNUM
	int "Number of frame buffers for video"
	default 3
	---help---
		The number of frame buffers for video data. Default:3

config EXAMPLES_CAMERA_STILL_BUFNUM
	int "Number of frame buffers for still"
	default 1
	---help---
		The number of frame buffers for still data. Default:1

config EXAMPLES_CAMERA_MAX_CAPTURE_NUM
	int "Max number of captures"
	default 100
	---help---
		The maximum number of captures as threshold in command argument. Default:100

config EXAMPLES_CAMERA_DEFAULT_CAPTURE_NUM
	int "Default number of captures"
	default 10
	---help---
		The default number of captures. Default:10

config EXAMPLES_CAMERA_START_CAPTURE_TIME
	int "Start capture time (seconds)"
	default 5
	---help---
		The wait value until the start of capture. Default:5

config EXAMPLES_CAMERA_KEEP_VIDEO_TIME
	int "Keep video time (seconds)"
	default 10
	---help---
		The period value for dispaying on the LCD after the end of capture. Default:10

config EXAMPLES_CAMERA_SPOT_METERING_POSX
	int "Position x-axis for spot metering"
	default 10
	---help---
		The x-axis value for spot metering position. Default:10

config EXAMPLES_CAMERA_SPOT_METERING_POSY
	int "Position y-axis for spot metering"
	default 20
	---help---
		The y-axis value for spot metering position. Default:20
endif
```

## examples/nrc7292_fwupdate/Kconfig
```kconfig
#
# For a description of the syntax of this configuration file,
# see the file kconfig-language.txt in the NuttX tools repository.
#

config EXAMPLES_NRC7292_FWUPDATE
	tristate "NRC7292 firmwrae update example"
	default n
	---help---
		NRC7292 firmwrae update example

if EXAMPLES_NRC7292_FWUPDATE

config EXAMPLES_NRC7292_FWUPDATE_PROGNAME
	string "Program name"
	default "nrc7292_fwupdate"
	---help---
		This is the name of the program that will be used when the NSH ELF
		program is installed.

config EXAMPLES_NRC7292_FWUPDATE_PRIORITY
	int "nrc7292_fwupdate task priority"
	default 100

config EXAMPLES_NRC7292_FWUPDATE_STACKSIZE
	int "Hello stack size"
	default DEFAULT_TASK_STACKSIZE

endif
```

## wireless/nrc7292/Kconfig
```kconfig
#
# For a description of the syntax of this configuration file,
# see the file kconfig-language.txt in the NuttX tools repository.
#

config WIRELESS_NRC7292
	tristate "Newracom NRC7292 usrsock daemon"
	default n
	depends on NET_USRSOCK && WL_NRC7292
	select NET_USRSOCK_TCP
	select PIPES
	select TIMER_FD
	---help---
		Enable support for the nrc7292 usrsock daemon

if WIRELESS_NRC7292
config WIRELESS_NRC7292_PROGNAME
	string "nrc7292 program name"
	default "nrc7292"
	---help---
		Command-line command name of Usersock daemon task for NRC7292.

config WIRELESS_NRC7292_PRIORITY
	int "nrc7292 task priority"
	default 100
	---help---
		Task priority of Usercok daemon.

config WIRELESS_NRC7292_STACKSIZE
	int "nrc7292 stack size"
	default 4096
	---help---
		Stack size of Usercok daemon.

config WIRELESS_NRC7292_HALOW_STA_DHCPCLIENT
	bool "DHCP Client"
	default y
	---help---
		Use internal DHCP Client in NRC7292.

config WIRELESS_NRC7292_HALOW_AP_DHCPSERVER
	bool "DHCP Server"
	default y
	---help---
		Enable DNCP Server in NRC7292.

config WIRELESS_NRC7292_ATSSEND_TIMEOUT
	int "AT+SSEND command timeout (second)"
	default 10
	---help---
		Timeout setting for AT+SSEND command. Unit is second.
		This command will block any other SSEND command until finishing previous
		previous command, or expireing the timeout.

config WIRELESS_NRC7292_HALOW_REGDOM_CHECK_ENABLE
	bool "Regulatory domain check"
	default n
	---help---
		When this option is enabled, nrc7292 daemon checks regulatory domain for
		setting of band frequency.

if WIRELESS_NRC7292_HALOW_REGDOM_CHECK_ENABLE
config WIRELESS_NRC7292_HALOW_REGDOM_US_ENABLE
	bool "US"
	default y
	---help---
		Enable to check "United State" domain

config WIRELESS_NRC7292_HALOW_REGDOM_KR_ENABLE
	bool "KR"
	default y
	---help---
		Enable to check "Korea" domain

config WIRELESS_NRC7292_HALOW_REGDOM_JP_ENABLE
	bool "JP"
	default y
	---help---
		Enable to check "Japan" domain

config WIRELESS_NRC7292_HALOW_REGDOM_TW_ENABLE
	bool "TW"
	default y
	---help---
		Enable to check "Taiwan" domain

config WIRELESS_NRC7292_HALOW_REGDOM_EU_ENABLE
	bool "EU"
	default y
	---help---
		Enable to check "European Union" domain

config WIRELESS_NRC7292_HALOW_REGDOM_CN_ENABLE
	bool "CN"
	default y
	---help---
		Enable to check "China" domain

config WIRELESS_NRC7292_HALOW_REGDOM_NZ_ENABLE
	bool "NZ"
	default y
	---help---
		Enable to check "New Zealand" domain

config WIRELESS_NRC7292_HALOW_REGDOM_AU_ENABLE
	bool "AU"
	default y
	---help---
		Enable to check "Australia" domain

config NRC7292_SPECIFIC_DEFAULT_BANDFREQUENCY
	bool "Use user specific default band frequency"
	default n
	---help---
		Enable to use user-specific default band frequency.

if NRC7292_SPECIFIC_DEFAULT_BANDFREQUENCY

config NRC7292_SPECIFIC_DEFAULT_BANDFREQUENCY_KHZ
	int "Band frequency of Wi-Fi Halow"
	default 921000
	---help---
		Band frequency of Wi-Fi Halow network

endif

endif

endif
```
